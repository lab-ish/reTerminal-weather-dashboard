## firmware/main/Kconfig.projbuild
```kconfig
menu "reTerminal Weather"

    config WIFI_SSID
        string "Wi-Fi SSID"
        default ""
        help
            接続先 Wi-Fi の SSID。

    config WIFI_PASSWORD
        string "Wi-Fi password"
        default ""
        help
            接続先 Wi-Fi のパスワード（WPA2-PSK）。

endmenu
```

## firmware/sdkconfig.defaults
```kconfig
# ESP32-S3 / reTerminal E1002（PSRAM 8MB, Flash 32MB）
CONFIG_IDF_TARGET="esp32s3"

# Flash 32MB
CONFIG_ESPTOOLPY_FLASHSIZE_32MB=y
CONFIG_ESPTOOLPY_FLASHSIZE="32MB"

# PSRAM（8MB, Octal SPI）— 187.5KB フレームバッファを PSRAM に確保する
CONFIG_SPIRAM=y
CONFIG_SPIRAM_MODE_OCT=y
CONFIG_SPIRAM_SPEED_80M=y
CONFIG_SPIRAM_USE_MALLOC=y

# カスタムパーティション
CONFIG_PARTITION_TABLE_CUSTOM=y
CONFIG_PARTITION_TABLE_CUSTOM_FILENAME="partitions.csv"

# HTTPS 用証明書バンドル（esp_crt_bundle_attach で github.io を検証）
CONFIG_MBEDTLS_CERTIFICATE_BUNDLE=y
CONFIG_MBEDTLS_CERTIFICATE_BUNDLE_DEFAULT_FULL=y

# 低消費電力: deep sleep 前提。ログは M8 実機調整で絞る
CONFIG_LOG_DEFAULT_LEVEL_INFO=y

# main タスクで HTTPS(mbedTLS + 証明書バンドル) を実行するため既定 3584B では
# スタックオーバーフローする。M8 実機で確認し 12KB へ拡大。
CONFIG_ESP_MAIN_TASK_STACK_SIZE=12288
```
